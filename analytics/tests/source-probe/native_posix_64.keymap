#include <behaviors.dtsi>
#include <dt-bindings/zmk/kscan_mock.h>

/ {
    keymap {
        compatible = "zmk,keymap";
        default_layer {
            bindings = <&none &none &none &none>;
        };
    };
};

/* The probe exits before this synthetic event. */
&kscan {
    events = <ZMK_MOCK_PRESS(0, 0, 10000)>;
};
