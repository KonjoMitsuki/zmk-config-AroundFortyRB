## Kconfig
```kconfig
config ARROUNDFORTY_STATUS_LED
    bool "Independent Clip Studio (left) and AML (right) LED indicators"
    depends on RGBLED_WIDGET && ZMK_SPLIT && ZMK_SPLIT_BLE
    depends on SHIELD_ARROUNDFORTY_RB_L || SHIELD_ARROUNDFORTY_RB_R
```

## analytics/Kconfig
```kconfig
menuconfig ZMK_ANALYTICS
    bool "Keyboard analytics event-source PoC (experimental)"
    default n
    depends on !ZMK_SPLIT || ZMK_SPLIT_ROLE_CENTRAL
    help
      Source-event counters for the v0.3.0 correctness PoC.
      Optional development USB transport and two-generation persistence.
      Not the analytics MVP.
      The linker wrapper requires the audited ZMK sources and LTO disabled.

if ZMK_ANALYTICS

config ZMK_ANALYTICS_PERSISTENCE
    bool "Persist counters, timing histograms and directed bigrams"
    default n
    depends on SETTINGS_NVS
    help
      Two-generation analytics_poc/a,b records for counters and timing, plus
      c,d records for directed bigrams. Does not clear existing settings.
      Only physical position data, not logical keymap data. Requires an
      explicit layout ID. The RAM-only recent press order is not saved.

config ZMK_ANALYTICS_PAIR_LIST
    string "Comma-separated unordered position pairs for timing histograms"
    default "0:1"
    help
      Example "0:1,1:2". Positions are physical ids. Order inside a pair is
      ignored. Invalid tokens and pairs beyond 16 are counted as configuration
      errors and skipped.

config ZMK_ANALYTICS_LAYOUT_ID
    string "Physical position mapping identity (manually versioned)"
    default ""
    depends on ZMK_ANALYTICS_PERSISTENCE

config ZMK_ANALYTICS_SAVE_INTERVAL_SECONDS
    int "Automatic save interval (seconds)"
    default 600
    range 600 86400
    depends on ZMK_ANALYTICS_PERSISTENCE

config ZMK_ANALYTICS_USB_POC
    bool "Unprotected analytics USB port (development only)"
    default n
    depends on USB_CDC_ACM && UART_LINE_CTRL && UART_INTERRUPT_DRIVEN && ZMK_USB
    help
      A dedicated second CDC ACM port accepting GET, SAVE, BIGRAMS and RECENT.
      No unlock required: any connected host application can read statistics
      and the RAM-only recent press order.
      Requires usb-poc.overlay. Never shares the Studio UART.

config ZMK_ANALYTICS_POC_REPORT
    bool "Print aggregate counters on native simulator exit (tests only)"
    default n
    depends on BOARD_NATIVE_POSIX_64BIT && !ZMK_BLE && !ZMK_USB
    help
      Only for synthetic native_posix_64 regression tests. Never enable
      aggregate logging on a keyboard used for real input.

endif
```

## config/west.yml
```yaml
manifest:
  remotes:
    - name: zmkfirmware
      url-base: https://github.com/zmkfirmware
    # PMW3610センサーモジュール
    - name: badjeff
      url-base: https://github.com/badjeff
    # RGB Widgetモジュール
    - name: caksoylar
      url-base: https://github.com/caksoylar
    # Tri-stateビヘイビア（Swapper）
    - name: dhruvinsh
      url-base: https://github.com/dhruvinsh
  projects:
    - name: zmk
      remote: zmkfirmware
      revision: v0.3.0
      import: app/west.yml
    - name: zmk-pmw3610-driver
      remote: badjeff
      revision: zmk-0.3
    - name: zmk-rgbled-widget
      remote: caksoylar
      # Pinned for the persistent-color adapter in src/aroundforty_status_led.c.
      revision: 8756cb7b8114069fa3c25c6f6c990f24988fceff
    - name: zmk-tri-state
      remote: dhruvinsh
      revision: main
  self:
    path: config
```

## dts/bindings/behaviors/zmk,behavior-aroundforty-status-led.yaml
```yaml
description: Internal split command for the AroundForty left Clip Studio LED
compatible: "zmk,behavior-aroundforty-status-led"
include: one_param.yaml
properties:
  clip-layer:
    type: int
    required: true
  aml-layer:
    type: int
    required: true
  aml-on-layer:
    type: int
    required: true
```
